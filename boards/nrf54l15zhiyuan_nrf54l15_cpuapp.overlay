/*
 * Copyright (c) 2025 Nordic Semiconductor ASA
 *
 * SPDX-License-Identifier: LicenseRef-Nordic-5-Clause
 */

/ {
	cs_antenna_switch: cs-antenna-config {
		status = "okay";
		compatible = "nordic,bt-cs-antenna-switch";
		ant-gpios = <&gpio0 1 (GPIO_ACTIVE_LOW)>,
			    <&gpio0 0 (GPIO_ACTIVE_LOW)>;
		multiplexing-mode = <0>;
	};
};
